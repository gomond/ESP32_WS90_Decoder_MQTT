## main/Kconfig.projbuild
```kconfig
menu "WS90 MQTT Configuration"

config WS90_WIFI_SSID
    string "Wi-Fi SSID"
    default ""

config WS90_WIFI_PASS
    string "Wi-Fi Password"
    default ""

config WS90_MQTT_BROKER_URI
    string "MQTT Broker URI"
    default "mqtt://192.168.1.10:1883"

config WS90_MQTT_USERNAME
    string "MQTT Username"
    default ""

config WS90_MQTT_PASSWORD
    string "MQTT Password"
    default ""

config WS90_MQTT_CLIENT_ID
    string "MQTT Client ID"
    default "ws90-decoder"

config WS90_MQTT_TLS_SKIP_VERIFY
    bool "Skip TLS certificate hostname (CN) verification"
    default n
    help
        When enabled, the MQTT client skips the TLS certificate common-name
        (hostname) check when connecting via mqtts://. The certificate chain
        is still validated against the CA store built into the firmware.
        Enable this when connecting to cloud or subscription MQTT brokers whose
        certificate CN does not exactly match the broker URI hostname. This is
        insecure (man-in-the-middle risk) and should only be used on trusted
        networks or for development purposes.

config WS90_MQTT_STATE_TOPIC
    string "MQTT State Topic"
    default "ws90/state"

config WS90_REQUIRE_EXPECTED_ID
    bool "Require expected WS90 station ID"
    default y

config WS90_RADIO_DIAGNOSTICS
    bool "Enable periodic radio diagnostics"
    default y

config WS90_DIAG_INTERVAL_MS
    int "Radio diagnostics interval (ms)"
    range 500 60000
    default 3000
    depends on WS90_RADIO_DIAGNOSTICS

config WS90_PIN_MISO
    int "RFM69 SPI MISO GPIO"
    range 0 48
    default 19

config WS90_PIN_MOSI
    int "RFM69 SPI MOSI GPIO"
    range 0 48
    default 27

config WS90_PIN_SCK
    int "RFM69 SPI SCK GPIO"
    range 0 48
    default 5

config WS90_PIN_CS
    int "RFM69 SPI CS GPIO"
    range 0 48
    default 18

config WS90_PIN_RST
    int "RFM69 reset GPIO"
    range 0 48
    default 14

config WS90_DISPLAY_ENABLE
    bool "Enable onboard SSD1306 display"
    default y

config WS90_DISPLAY_I2C_PORT
    int "Display I2C port"
    range 0 1
    default 0
    depends on WS90_DISPLAY_ENABLE

config WS90_DISPLAY_SDA
    int "Display I2C SDA GPIO"
    range 0 48
    default 21
    depends on WS90_DISPLAY_ENABLE

config WS90_DISPLAY_SCL
    int "Display I2C SCL GPIO"
    range 0 48
    default 22
    depends on WS90_DISPLAY_ENABLE

config WS90_DISPLAY_ADDR
    hex "SSD1306 I2C address"
    range 0x3C 0x3D
    default 0x3C
    depends on WS90_DISPLAY_ENABLE

endmenu
```
